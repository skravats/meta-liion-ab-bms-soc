## conf/layer.conf
```bitbake
# We have a conf and classes directory, append to BBPATH
BBPATH .= ":${LAYERDIR}"

# We have a recipes directory, add to BBFILES
BBFILES += "${LAYERDIR}/recipes*/*/*.bb \
            ${LAYERDIR}/recipes*/*/*.bbappend"

BBFILE_COLLECTIONS += "meta-liion-ab-bms-soc"
BBFILE_PATTERN_meta-liion-ab-bms-soc := "^${LAYERDIR}/"
BBFILE_PRIORITY_meta-liion-ab-bms-soc = "7"
LAYERSERIES_COMPAT_meta-liion-ab-bms-soc = "warrior zeus"
```

## conf/machine/liion-ab-bms-soc.conf
```bitbake
#@TYPE: Machine
#@NAME: liion-ab-bms-soc
#@DESCRIPTION: Machine configuration for the Liion AB/BMSBoard"

require conf/machine/include/socfpga.inc

UBOOT_CONFIG ??= "liion-ab-bms-soc"
UBOOT_CONFIG[arrow-sockit] = "socfpga_cyclone5_ab_bms_soc_defconfig"

KMACHINE = "liion-ab-bms-soc"

# Default kernel devicetrees
KERNEL_DEVICETREE ?= "\
			socfpga_cyclone5_ab_bms_soc.dtb \
			"

SERIAL_CONSOLES ?= "115200;ttyS0"

UBOOT_EXTLINUX ?= "1"
UBOOT_EXTLINUX_LABELS ?= "default"
UBOOT_EXTLINUX_DEFAULT_LABEL ?= "Liion AB/BMS SDMMC"

UBOOT_EXTLINUX_FDT_default ?= "../socfpga_cyclone5_ab_bms_soc.dtb"
UBOOT_EXTLINUX_ROOT_default ?= "root=/dev/mmcblk0p3"
UBOOT_EXTLINUX_MENU_DESCRIPTION_default ?= "Liion AB/BMS SDMMC"
UBOOT_EXTLINUX_KERNEL_IMAGE_default ?= "../${KERNEL_IMAGETYPE}"
UBOOT_EXTLINUX_FDTDIR_default ?= "../"
UBOOT_EXTLINUX_KERNEL_ARGS_default ?= "rootwait rw earlycon"

IMAGE_BOOT_FILES ?= " \
	${KERNEL_DEVICETREE} \
	${KERNEL_IMAGETYPE} \
	extlinux.conf;extlinux/extlinux.conf \
	"

WKS_FILE ?= "sdimage-cyclone5-arria5.wks"
IMAGE_FSTYPES +="wic"
```
